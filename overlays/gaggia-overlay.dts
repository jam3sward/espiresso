/*
 * Device Tree overlay for Gaggia controller
 * Sets 14 and 15 to weak pull down inputs at boot up
 * (these are normally the UART TX/RX on the Pi)
 * When the controller eventually starts, these will
 * be reconfigured as outputs:
 *   14 will become Pump PWM output
 *   15 will become Pump Enable output
 *
 * This overlay needs to be copied to:
 *   /boot/overlays
 * Then a line needs to be added to /boot/config.txt
 * to load it as follows:
 *   dtoverlay=gaggia
 * 
 */

/dts-v1/;
/plugin/;

/ {
	compatible = "brcm,bcm2708";

	fragment@0 {
		target = <&gpio>;
		__overlay__ {
			pinctrl-names = "default";
			pinctrl-0 = <&gaggia_pins>;

			gaggia_pins: gaggia_pins {
				brcm,pins = <14 15>;
				brcm,function = <0 0>; /* in in */
				brcm,pull = <1 1>; /* down down */
			};
		};
	};
};
